#define ALLOCATE_EXTERN
#include "HC89S003F4.h"
#include "bluetooth.h"

/***************************************************************************************
  * @说明  	T1中断服务函数
  *	@参数	  无
  * @返回值 无
  * @注		  无
***************************************************************************************/
void TIMER1_Rpt(void) interrupt TIMER1_VECTOR
{

}

/***************************************************************************************
  * @说明  	UART1中断服务函数
  *	@参数	  无
  * @返回值	  无
  * @注		  无
***************************************************************************************/

void UART1_Rpt(void) interrupt UART1_VECTOR
{
	u8 i;
	
	if(SCON & 0x01)						        //判断接收中断标志位
	{
		i=SBUF;									//转存接收数据
		uart_receive_input(i);					//sdk提供的函数
		SCON &=~ 0x01;					        //清除接收中断标志位
	}
}

void Delay_us(uint q)
{
	uint j;
	for(j=0;j<q;j++)
	{
			;
	}
}

/***************************************************************************************
  * @说明  	系统初始化函数
  *	@参数	  无
  * @返回值 无
  * @注		  无
***************************************************************************************/
void InitSYS()
{
	/********************************系统频率初始化***************************************/
	CLKSWR = 0x51;						        //选择内部高频RC为系统时钟，内部高频RC 2分频，Fosc=16MHz
	CLKDIV = 0x01;						        //Fosc 1分频得到Fcpu，Fcpu=16MHz 
	FREQ_CLK = 0x10;							//IAP频率指示：16MHz
	
	/**********************************低压复位初始化**************************************/
	
	/***********************************看门口初始化***************************************/
	WDTC = 0x5F;								//允许WDT复位，空闲模式下禁止WDT，选择1024分频（内部低频时钟44K）
	//WDTCCR = 0x20;	//0X20/44	=0.73秒			//0xFF;	 //溢出时间约6秒
	WDTCCR = 0x0;		//关闭看门狗

	//溢出计算时间=（WDT分频系数*（WDTCCR+1））/内部低频RC频率
}

/***************************************************************************************
  * @说明  	定时器初始化函数
  *	@参数	  无
  * @返回值 无
  * @注		  无
***************************************************************************************/
void Timer_Init()
{
	/**********************************TIM1配置初始化**************************************/
	TCON1 = 0x00;						  //T1定时器时钟为Fosc/12
	TMOD = 0x01;						  //T1-16位重装载定时器/计数器,T0-16位定时器

	//Tim1计算时间 	= (65536 - 0xFACB) * (1 / (Fosc /Timer分频系数))
	//				= 1333 / (16000000 / 12)
	//				= 1 ms

	//定时1ms
	//反推初值 	= 65536 - ((1/1000) / (1/(Fosc / Timer分频系数)))
	//		   	= 65536 - ((1/1000) / (1/(16000000 / 12)))
	//			= 65536 - 1333
	//			= 0xFACB
	
	TH1 = 0xFA;
	TL1 = 0xCB;

	IE |= 0x08;							  //打开T1中断
	TCON |= 0x40;						  //使能T1
    
	
		
	TH0 = 0xCB;
	TL0 = 0xEB;							  //T0定时时间10ms
	
	TCON |= 0x10;						  //使能T0
}

/***************************************************************************************
  * @说明  	UART1初始化函数
  *	@参数	  无
  * @返回值 无
  * @注		  无
***************************************************************************************/
void UART1_Init()
{
	/**********************************UART配置初始化**************************************/
	P2M0 = P2M0&0xF0|0x08;				      //P20设置为推挽输出 txd

	P0M2 = P0M2&0xF0|0x02;				      //P04设置为上拉输入


	P0_4 = 1;
	TXD_MAP = 0x20;						          //TXD映射P20
	RXD_MAP = 0x04;						          //RXD映射P04


	T4CON = 0x06;						            //T4工作模式：UART1波特率发生器
	
	//波特率计算
	//波特率 = 1/16 * (T4时钟源频率 / 定时器4预分频比) / (65536 - 0xFF98)
	//       = 1/16 * ((16000000 / 1) / 104)
	//		 = 9615.38(误差0.16%)

	//波特率9600
	//反推初值 = (65536 - ((T4时钟源频率 / 定时器4预分频比) * (1 / 16)) / 波特率)
	//		   = (65536 - (16000000 * (1 / 16) / 9600))
	//		   = (65536 - 104.167)
	//         = FF98
	//0xFF98->9600
	//0xFFCC->19200
	//0xFFEF->57600
	
	
    TH4 = 0xFF;
	TL4 = 0x98;	//波特率9600		//0xEE;			  //波特率56000
	SCON2 = 0x02;						             //8位UART，波特率可变
	SCON = 0x10;					                 //允许串行接收
	IE |= 0X10;							             //使能串口中断
}

/***************************************************************************************
  * @说明  	ADC初始化函数
  *	@参数	  无
  * @返回值   无
  * @注		  无
***************************************************************************************/
void ADC_Init()
{
	ADCC0 |= 0x03;						  //参考源为内部2V
	ADCC0 |= 0x80;						  //打开ADC转换电源
	Delay_us(20);					 	  //延时20us，确保ADC系统稳定
	ADCC1 = 0x01;						  //选择外部通道1
	ADCC2 = 0x4B;					//8分频	  //转换结果12位数据，数据右对齐，ADC时钟16分频-1MHZ//0X4B-8分频//0X49-4分频
}

/***************************************************************************************
  * @说明  	IO口初始化函数
  *	@参数	  无
  * @返回值 无
  * @注		  无
***************************************************************************************/
void GPIO_Init()
{
	P0M0 = P0M0&0x0F|0x30;				  //P01设置为模拟输入     雷达adc
}

void send_data(u8 d)
{
	SBUF = d;
	while(!(SCON & 0x02));
	SCON &=~ 0x02;
}

uchar read_ad(uchar ch)
{
	u8 i;
	uint  ad_sum;
	
	ADCC1 = ch;						//选择外部通道
	ADCC0 |= 0x40;					//启动ADC转换
	while(!(ADCC0&0x20));			//等待ADC转换结束
	ADCC0 &=~ 0x20;					//清除标志位
	
	Delay_us(100);
	
	ad_sum=0;

	for(i=0;i<16;i++)
	{
		ADCC0 |= 0x40;				//启动ADC转换
		while(!(ADCC0&0x20));		//等待ADC转换结束
		ADCC0 &=~ 0x20;				//清除标志位
		ad_sum += ADCR;				//获取ADC的值
		
		Delay_us(20);
	}
	
	ADCC1 =1;
	i=ad_sum>>8;
	
	Delay_us(100);
	return(i);
}

/***************************************************************************************
  * @说明  	主函数
  *	@参数	  无
  * @返回值 无
  * @注		  无
***************************************************************************************/
void main()
{
	InitSYS();
	GPIO_Init();
	Timer_Init();
	UART1_Init();
	ADC_Init();
	bt_protocol_init();

	EA=1;

	while(1)
	{
		bt_uart_service();	//sdk函数
		Delay_us(100);
	}
}


